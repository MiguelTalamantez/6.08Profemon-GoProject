#include <mpu6050_esp32.h> //Used for ESP32 stuff
#include<string.h> //used for some string handling and processing.
#include <TFT_eSPI.h> // Graphics and font library for ST7735 driver chip
#include <SPI.h> //Used in support of TFT Display
#include <WiFi.h> //Connect to WiFi Network
TFT_eSPI tft = TFT_eSPI();  // Invoke library, pins defined in User_Setup.h
MPU6050 imu; //imu object called, appropriately, imu

//Button Setup
const int BUTTON1 = 45; //Button1 at pin 45
const int BUTTON2 = 39; //Button2 at pin 39
const int BUTTON3 = 38; //Button3 at pin 38
const int BUTTON4 = 34; //Button4 at pin 34

//State machine variables
int overallstate = 0;
int mapstate = 0;
int catchstate = 0;

//variables
bool displaytext = true;
bool askifcatch = false;
bool catchbuttons = false;
// bool askiftrue = false;
float userlocationx =     42.359806; //simmons x        42.357008;//Bridge      42.361863;//Dlab
float userlocationy =     -71.094074; //simmons y      -71.092526;//Bridge     -71.097723;//Dlab
float testproflocationx = 42.359806; // 360263
float testproflocationy = -71.095074; //092482
float deltax = 0;
float deltay = 0;
float rdistance = 0;

//TFT Location to LCD related variables
float tft_x_min_geolocation = 42.359747;
float tft_y_min_geolocation = -71.084955;
float tft_x_max_geolocation = 42.365440;
float tft_y_max_geolocation =  -71.101831;
float y_change_geolocation = 0.009876;
float x_change_geolocation = 0.005893;
int tft_x_min_LCD = 0;
int tft_y_min_LCD = 0;
int tft_x_max_LCD = 128;
int ftf_y_max_LCD = 160;
int userdisplaytimer = 0;

static const uint8_t  PROGMEM my_map[] = {

  0x80, 0x00, 0x08, 0x00, 0x00, 0x00, 0x18, 0x03, 0x00, 0x40, 0x00, 0xd0, 0x80, 0x04, 0x00, 0x00, 
  0x00, 0x00, 0x0c, 0x40, 0x00, 0x00, 0x07, 0x01, 0x00, 0x60, 0x01, 0x80, 0xa4, 0x0a, 0xa8, 0x39, 
  0x00, 0x00, 0x18, 0x08, 0x00, 0x00, 0x01, 0x90, 0x40, 0x30, 0x01, 0xd1, 0x44, 0x05, 0x8d, 0x5f, 
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  0xfc, 0x50, 0x00, 0x00, 0x44, 0x40, 0x00, 0x00, 0x00, 0x07, 0xc8, 0x20, 0x18, 0x00, 0x07, 0xc1, 
};





void setup() {
    //LCD + SERIAL SETUP
    tft.init();
    tft.setRotation(2);
    tft.setTextSize(1);
    tft.fillScreen(TFT_BLACK);
    tft.setCursor(0,0,1);
    tft.setTextColor(TFT_WHITE, TFT_BLACK);
    tft.println("Insert nice animation here");
    tft.println("");
    tft.println("WELCOME TO PROF-EMON GO!");

    Serial.begin(115200);
    Serial.println("Welcome to Prof-emons Go! - Serial View");

    //Button setup
    pinMode(BUTTON1, INPUT_PULLUP); //set input pin as an input button1
    pinMode(BUTTON2, INPUT_PULLUP); //set input pin as an input button2
    pinMode(BUTTON3, INPUT_PULLUP); //set input pin as an input button3
    pinMode(BUTTON4, INPUT_PULLUP); //set input pin as an input button4

  delay(3000);
    tft.fillScreen(TFT_BLACK);
    tft.drawXBitmap(0, 0, my_map, 128, 160, 0xFFFF);
    userdisplaytimer = millis();


}

void loop() {
  //READ DATA
    uint8_t button1 = digitalRead(BUTTON1);
    uint8_t button2 = digitalRead(BUTTON2); 
    uint8_t button3 = digitalRead(BUTTON3);
    uint8_t button4 = digitalRead(BUTTON4);
    
  //DISPLAY TEXT
    if (displaytext == true){
    Serial.println("Current OverallState:");
    Serial.println(overallstate);
    Serial.println("Current MapState: ");
    Serial.println(mapstate);
    Serial.println("Current CatchState: ");
    Serial.println(catchstate);
    displaytext = false;
    }

  //PROF Detection code
    if (userlocationx > testproflocationx){
    deltax = (userlocationx) - (testproflocationx);
    }
    else if (userlocationx < testproflocationx){
      deltax = (testproflocationx) - (userlocationx);
    }
    if (userlocationy > testproflocationy){
      deltay = (userlocationy) - (testproflocationy);
    }
    else if (userlocationy < testproflocationy){
      deltay = (testproflocationy) - (userlocationy);
    }
    rdistance = sqrt(pow(deltax, 2) + pow(deltay, 2));
    // Serial.println(rdistance, 6);

    if (rdistance <= 0.0015){
      askifcatch = true;
    }
    if (askifcatch == true){
      tft.setCursor(0,0);
      tft.print("DO YOU WANT TO CATCH THIS PROFEMON?");
      catchbuttons = true;
      // askiftrue = false;
    }
    if (catchbuttons == true)
      if (button1 == 0){
      overallstate = 1;
      displaytext = true;
      }
      if (button2 == 0){
      overallstate = 0;
      displaytext = true;
      }

  //Display User on map
    if (millis() - userdisplaytimer > 2000){
      Serial.println("TIMER RESET");
      userdisplaytimer = millis();
      float percentagex = abs ( (userlocationx-tft_x_min_geolocation)/(tft_x_max_geolocation-tft_x_min_geolocation) );
      float percentagey = abs ( (userlocationy-tft_y_min_geolocation)/(tft_y_max_geolocation-tft_y_min_geolocation) );
      Serial.println(percentagex, 6);
      Serial.println(percentagey, 6);
      
      tft.drawCircle(percentagex*128, 160 - percentagey*160, 3, TFT_YELLOW);
      // tft.drawCircle(10, 80, 3, TFT_YELLOW);
    }

  overallstatefunction(button1, button2, button3, button4);
  //fakebuttontrigger(button1, button2, button3, button4);


}

void overallstatefunction(uint8_t button1, uint8_t button2, uint8_t button3, uint8_t button4){
  switch(overallstate){
    case(0):
      //Map Mode
      //tft.setCursor(0,100);
      //Serial.println("Displaying map");
      break;
    case(1):
      //Display nice UI graphics
      overallstate = 2;
      displaytext = true;
      Serial.println("State 1");
      Serial.println("State 2");
      break;
    case(2):
      //Catch Mode
      //tft.setCursor(0,100);
      //Serial.println("Catching Pokemon");
      break;
    case(3):
      //Display nice UI graphics
      overallstate = 0;
      displaytext = true;
      Serial.println("State 3");
      Serial.println("State 0");
      break;
    case(4):
      //Display nice UI graphics + Store Prof-emon in Database
      Serial.println("YOU CAUGHT A POKEMON");
      overallstate = 0;
      displaytext = true;
      Serial.println("State 4");
      Serial.println("State 0");
      break;
    case(5):
      //Display nice UI graphics 
      overallstate = 6;
      displaytext = true;
      Serial.println("State 5");
      break;
    case(6):
      //Fight Mode
      //tft.setCursor(0,100);
      //Serial.println("Fighting a Pokemon");
      break;
    case(7):
      //Display nice UI graphics that say YOU LOST
      Serial.println("YOU LOST");
      overallstate = 0;
      displaytext = true;
      Serial.println("State 7");
      break;
    case(8):
      Serial.println("YOU WON");
      overallstate = 0;
      displaytext = true;
      Serial.println("State 8");
      break;
  }
}


void mapstatefunction(uint8_t button1, uint8_t button2, uint8_t button3, uint8_t button4){

// switch(mapstate){
//   case(0):
//     //Idle mode
//     // if professor is < distance
//       //mapstate = 1;
//     break;
//   case(1):
//     //Propose catch
//     break;
//   case(2):
//     //change to CATCHING POKEMON overall state
//     mapstate = 0;
//     break;
//   case(3):
//     //set timer to ask again
//     mapstate = 0;
//     break;
// }

}



void fakebuttontrigger(uint8_t button1, uint8_t button2, uint8_t button3, uint8_t button4){

  if (button1 == 0){
    if (overallstate == 0){
      overallstate = 1;
      displaytext = true;
      delay(100);
    }
  }
  if (button2 == 0){
    if (overallstate == 2){
      overallstate = 4;
      displaytext = true;
      delay(100);
    }
  }
  if (button3 == 0){
    if (overallstate == 2){
      overallstate = 3;
      displaytext = true;
      delay(100);
    }
  }
  if (button2 == 0){
    if (overallstate == 0){
      overallstate = 5;
      displaytext = true;
      delay(100);
    }
  }
  if (button3 == 0){
    if (overallstate == 6){
      overallstate = 8;
      displaytext = true;
      delay(100);
    }
  }
  if (button4 == 0){
    if (overallstate == 6){
      overallstate = 7;
      displaytext = true;
      delay(100);
    }
  }

}



